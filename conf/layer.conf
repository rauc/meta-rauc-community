## conf/layer.conf
```bitbake
# We have a conf and classes directory, add to BBPATH
BBPATH .= ":${LAYERDIR}"

# We have recipes-* directories, add to BBFILES
BBFILES += "${LAYERDIR}/recipes-*/*/*.bb \
            ${LAYERDIR}/recipes-*/*/*.bbappend"

BBFILE_COLLECTIONS += "meta-rauc-community"
BBFILE_PATTERN_meta-rauc-community = "^${LAYERDIR}/"
BBFILE_PRIORITY_meta-rauc-community = "6"

LAYERDEPENDS_meta-rauc-community = "core"
LAYERSERIES_COMPAT_meta-rauc-community = "dunfell"
```

## meta-rauc-beaglebone/conf/layer.conf
```bitbake
# We have a conf and classes directory, add to BBPATH
BBPATH .= ":${LAYERDIR}"

# We have recipes-* directories, add to BBFILES
BBFILES += "${LAYERDIR}/recipes-*/*/*.bb \
            ${LAYERDIR}/recipes-*/*/*.bbappend"

BBFILE_COLLECTIONS += "meta-rauc-beaglebone"
BBFILE_PATTERN_meta-rauc-beaglebone = "^${LAYERDIR}/"
BBFILE_PRIORITY_meta-rauc-beaglebone = "6"

LAYERDEPENDS_meta-rauc-beaglebone = "core rauc yoctobsp"
LAYERSERIES_COMPAT_meta-rauc-beaglebone = "walnascar"

RAUC_KEY_FILE ?= "${LAYERDIR}/../files/rauc-example-keys/development-1.key.pem"
RAUC_CERT_FILE ?= "${LAYERDIR}/../files/rauc-example-keys/development-1.cert.pem"
RAUC_KEYRING_FILE ?= "${LAYERDIR}/../files/rauc-example-keys/ca.cert.pem"
```

## meta-rauc-beagleplay/wic/beaglebone-yocto-dual.wks
```
# short-description: Create SD card image for Beaglebone
# long-description: Creates a partitioned SD card image for Beaglebone.
# Boot files are located in the first vfat partition.

#part --source bootimg-partition --ondisk mmcblk0 --fstype=vfat --label boot --active --align 4 --fixed-size 128M --sourceparams="loader=u-boot" --use-uuid
#part --source rootfs --ondisk mmcblk0 --fstype=ext4 --label rootfs_A --align 1024 --use-uuid
#part --source rootfs --ondisk mmcblk0 --fstype=ext4 --label rootfs_B --align 1024 --use-uuid
#part --fixed-size 100M --ondisk mmcblk0 --fstype=ext4 --label data --align 1024

#bootloader --append="console=ttyS0,115200"



#part --source bootimg-partition --fstype=vfat --label boot --active --align 1024 --use-uuid --fixed-size 128M
#part / --source rootfs --fstype=ext4 --label root --align 1024 --use-uuid
bootloader --ptable msdos
part --ondisk mmcblk0 --fixed-size 64M   --fstype=vfat --label uboot   --source bootimg-partition --active --offset 64k
part --ondisk mmcblk0 --fixed-size 1500M --fstype=ext4 --label rootfs0 --source rootfs
part --ondisk mmcblk0 --fixed-size 1500M --fstype=ext4 --label rootfs1 --source rootfs
part --ondisk mmcblk0 --fixed-size 100M  --fstype=ext4 --label data
```

## meta-rauc-dhsom-stm32-bsp/conf/layer.conf
```bitbake
# We have a conf and classes directory, add to BBPATH
BBPATH .= ":${LAYERDIR}"

# We have recipes-* directories, add to BBFILES
BBFILES += "${LAYERDIR}/recipes-*/*/*.bb \
            ${LAYERDIR}/recipes-*/*/*.bbappend"

BBFILE_COLLECTIONS += "meta-rauc-dhsom-stm32-bsp"
BBFILE_PATTERN_meta-rauc-dhsom-stm32-bsp = "^${LAYERDIR}/"
BBFILE_PRIORITY_meta-rauc-dhsom-stm32-bsp = "6"

LAYERDEPENDS_meta-rauc-dhsom-stm32-bsp = "core rauc mainlinecommon-layer dhsomstm32bsp"
LAYERSERIES_COMPAT_meta-rauc-dhsom-stm32-bsp = "scarthgap"
```

## meta-rauc-dhsom-stm32-bsp/wic/emmcimage-dual-stm32mp13.wks
```
# short-description: Create DH STM32MP13 eMMCcard dual image with a boot partition
# long-description: Creates a partitioned eMMC card image. Boot files
# are located in the first ext4 partition.

part / --source rootfs --ondisk mmcblk0 --fstype=ext4 --label rootfs_A --part-name "rootfsA" --align 4096 --use-uuid --active
part / --source rootfs --ondisk mmcblk0 --fstype=ext4 --label rootfs_B --part-name "rootfsB" --align 4096 --use-uuid --active
part /data --fixed-size 100M --ondisk mmcblk0 --fstype=ext4 --label data --align 4096

bootloader --ptable gpt
```

## meta-rauc-genericx86-64/conf/layer.conf
```bitbake
# We have a conf and classes directory, add to BBPATH
BBPATH .= ":${LAYERDIR}"

# We have recipes-* directories, add to BBFILES
BBFILES += "${LAYERDIR}/recipes-*/*/*.bb \
            ${LAYERDIR}/recipes-*/*/*.bbappend"

BBFILE_COLLECTIONS += "meta-rauc-genericx86-64"
BBFILE_PATTERN_meta-rauc-genericx86-64 = "^${LAYERDIR}/"
BBFILE_PRIORITY_meta-rauc-genericx86-64 = "6"

LAYERDEPENDS_meta-rauc-genericx86-64 = "core rauc"
LAYERSERIES_COMPAT_meta-rauc-genericx86-64 = "wrynose"

RAUC_KEY_FILE ?= "${LAYERDIR}/../files/rauc-example-keys/development-1.key.pem"
RAUC_CERT_FILE ?= "${LAYERDIR}/../files/rauc-example-keys/development-1.cert.pem"
RAUC_KEYRING_FILE ?= "${LAYERDIR}/../files/rauc-example-keys/ca.cert.pem"
```

## meta-rauc-nxp/conf/layer.conf
```bitbake
# We have a conf and classes directory, add to BBPATH
BBPATH .= ":${LAYERDIR}"

# We have recipes-* directories, add to BBFILES
BBFILES += "${LAYERDIR}/recipes-*/*/*.bb \
            ${LAYERDIR}/recipes-*/*/*.bbappend"

BBFILE_COLLECTIONS += "meta-rauc-nxp"
BBFILE_PATTERN_meta-rauc-nxp = "^${LAYERDIR}/"
BBFILE_PRIORITY_meta-rauc-nxp = "6"

LAYERDEPENDS_meta-rauc-nxp = "core rauc freescale-layer freescale-3rdparty"
LAYERSERIES_COMPAT_meta-rauc-nxp = "styhead"

RAUC_KEY_FILE ?= "${LAYERDIR}/../files/rauc-example-keys/development-1.key.pem"
RAUC_CERT_FILE ?= "${LAYERDIR}/../files/rauc-example-keys/development-1.cert.pem"
RAUC_KEYRING_FILE ?= "${LAYERDIR}/../files/rauc-example-keys/ca.cert.pem"
```

## meta-rauc-qemuarm/files/wic/rauc-qemuarm.wks
```
# short-description: Create Qemu disk image
# long-description: Creates a partitioned Qemu disk image for use with the RAUC update tool.
# The partition scheme provides:
# * a boot partition containing additional data used by the bootloader
# * two root file system partitions for atomic updates
# * a common data partition
#
# Note: Qemu does not come with a bundled u-boot, so the BIOS parameter is used to pass in the
# built binary. The system image does not contain the bootloader. 

bootloader --ptable gpt

part --ondisk vda --source bootimg-partition --fstype=vfat --active --fixed-size 16M --label bootfiles --align 4096

part / --ondisk vda --source rootfs --fstype=ext4 --fixed-size 250M --label root_a --align 4096
part / --ondisk vda --source empty --fstype=ext4 --fixed-size 250M --label root_b --align 4096

part /data --ondisk vda --fstype=ext4 --size 100M --label data
```

## meta-rauc-qemuarma9/conf/layer.conf
```bitbake
#
# Copyright (C) 2013 Wind River Systems, Inc.
#

# We have a conf and classes directory, add to BBPATH
BBPATH =. "${LAYERDIR}:"

# We have a packages directory, add to BBFILES
BBFILES += "${LAYERDIR}/recipes-*/*/*.bb \
 	${LAYERDIR}/recipes-*/*/*.bbappend"

BBFILE_COLLECTIONS += "qemuarma9"
BBFILE_PATTERN_qemuarma9 = "^${LAYERDIR}/"
BBFILE_PRIORITY_qemuarma9 = "7"

# This should only be incremented on significant changes that will
# cause compatibility issues with other layers
LAYERVERSION_qemuarma9 = "1"

LAYERDEPENDS_qemuarma9 = "core"

LAYERSERIES_COMPAT_qemuarma9 = "dunfell gatesgarth"
```

## meta-rauc-qemuarma9/conf/machine/qemuarma9.conf
```bitbake
#@TYPE: Machine
#@NAME: qemuarma9
#@DESCRIPTION: a9 vexpress

require qemuarma9.inc
require conf/machine/include/qemu.inc
DEFAULTTUNE ?= "armv7at"
require conf/machine/include/tune-cortexa9.inc

KERNEL_IMAGETYPE = "zImage"

SERIAL_CONSOLES ?= "115200;ttyAMA0 115200;ttyAMA1"

#Wic configuration
IMAGE_FSTYPES += "tar.bz2 wic wic.bmap"
WKS_FILE ?= "qemuarma9-yocto.wks"

# Files that will be included in boot partition
IMAGE_BOOT_FILES ?= "zImage vexpress-v2p-ca9.dtb uboot.env boot.scr"

IMAGE_INSTALL_append = " rauc kernel-image kernel-devicetree u-boot-fw-utils sd-img kernel-module-mmsens-drv"

CRIU_BUILD_ARCH = "armv7"

#Include u-boot
EXTRA_IMAGEDEPENDS += "u-boot"
UBOOT_MACHINE = "vexpress_ca9x4_defconfig"
# Include u-boot elf file in the images folder
UBOOT_ELF = "u-boot"

# Include u-boot default environment file
UBOOT_INITIAL_ENV = "uboot-init.env"
UBOOT_ENV_SIZE = "0x40000"

IMAGE_INSTALL_append = " rauc rauc-hawkbit-updater python3"
DISTRO_FEATURES_append = " systemd"
DISTRO_FEATURES_BACKFILL_CONSIDERED += "sysvinit"
VIRTUAL-RUNTIME_init_manager = "systemd"
VIRTUAL-RUNTIME_initscripts = "systemd-compat-units"
#DEPENDS += "rauc-hawkbit"

# For runqemu
QB_SYSTEM_NAME = "qemu-system-arm"
QB_MACHINE = "-machine vexpress-a9"
QB_DEFAULT_KERNEL = "u-boot.elf"
QB_AUDIO_DRV = "none"
QB_MEM = "-m 1024"
QB_KERNEL_ROOT = ""
QB_SERIAL_OPT = "-serial stdio"
# QB_KERNEL_CMDLINE_APPEND = "console=ttyAMA0,115200 console=tty"
# vexpress does not have any PCI bus to support virtio-rng-pci,
# We define specific virtio block device for it.
QB_ROOTFS_OPT = "-sd ${DEPLOY_DIR}/images/${MACHINE}/sd.img"
QB_TAP_OPT = "-netdev tap,id=net0,ifname=@TAP@,script=no,downscript=no"
# QB_SLIRP_OPT = "-netdev user,id=net0"
QB_OPT_APPEND = "-nographic"
# QB_DTB = "zImage-vexpress-v2p-ca9.dtb"
# Overwrite virtio-net-pci defined in oe-core/meta/classes/qemuboot.bbclass,
# since vexpress does not support it.
QB_NETWORK_DEVICE = "-device virtio-net-device,netdev=net0,mac=@MAC@"
```

## meta-rauc-qemuarma9/conf/machine/qemuarma9.inc
```bitbake
#
# Copyright (C) 2013 - 2018 Wind River Systems, Inc.
#
PCMCIA_MANAGER = "pcmciautils"
PREFERRED_PROVIDER_virtual/xserver ?= "xserver-kdrive"
PREFERRED_PROVIDER_virtual/libgl ?= "mesa"

MACHINE_FEATURES = "alsa pcmcia bluetooth irda usbgadget screen"

IMAGE_FSTYPES += "tar.bz2"
```

## meta-rauc-qemuarma9/wic/qemuarma9-yocto.wks
```
# short-description: Create SD card image for vexpress-a9
# long-description: Creates a partitioned SD card image for vexpress-a9.

part /boot --source bootimg-partition --ondisk mmcblk0 --fstype=ext4 --label boot --align 1024 --use-uuid --extra-space 100 --mkfs-extraopts="-O ^metadata_csum"
part --source rootfs --fstype=ext4 --ondisk mmcblk0 --use-uuid --label root_a --align 1024 --extra-space 500
part --source rootfs --fstype=ext4 --ondisk mmcblk0 --use-uuid --label root_b --align 1024 --extra-space 500
```

## meta-rauc-qemux86/conf/layer.conf
```bitbake
# We have a conf and classes directory, add to BBPATH
BBPATH .= ":${LAYERDIR}"

# We have recipes-* directories, add to BBFILES
BBFILES += "${LAYERDIR}/recipes-*/*/*.bb \
            ${LAYERDIR}/recipes-*/*/*.bbappend"

BBFILE_COLLECTIONS += "meta-rauc-qemux86"
BBFILE_PATTERN_meta-rauc-qemux86 = "^${LAYERDIR}/"
BBFILE_PRIORITY_meta-rauc-qemux86 = "6"

LAYERDEPENDS_meta-rauc-qemux86 = "core rauc"
LAYERSERIES_COMPAT_meta-rauc-qemux86 = "whinlatter"

RAUC_KEY_FILE ?= "${LAYERDIR}/../files/rauc-example-keys/development-1.key.pem"
RAUC_CERT_FILE ?= "${LAYERDIR}/../files/rauc-example-keys/development-1.cert.pem"
RAUC_KEYRING_FILE ?= "${LAYERDIR}/../files/rauc-example-keys/ca.cert.pem"
```

## meta-rauc-qemux86/wic/qemux86-grub-efi.wks
```
# short-description: Create Qemu disk image
# long-description: Creates a partitioned Qemu disk image for use with the RAUC
# update tool. The partitionging scheme provides:
# * a grub environment partition
# * a rescue partition
# * a bootloader partition with extra space for a shadow copy for atomic bootloader updates
# * two root file system partitions for atomic updates
# * a common data partition

bootloader --ptable gpt
part --fixed-size 50M --source rawcopy --sourceparams="file=efi-boot.vfat" --fstype=vfat --ondisk sda --label boot --active --align 4096
part --fixed-size 50M --ondisk sda --align 4096 --no-table
part --fixed-size 10M --source rawcopy --sourceparams="file=grubenv.vfat" --fstype=vfat --ondisk sda --label grubenv --align 1024
part /rescue --source rootfs --ondisk sda --fstype=ext4 --label rescue --align 1024
part / --source rootfs --ondisk sda --fstype=ext4 --label root_a --align 4096
part / --source rootfs --ondisk sda --fstype=ext4 --label root_b --align 4096
part /data --fixed-size 50M --ondisk sda --fstype=ext4 --label data --align 4096
```

## meta-rauc-raspberrypi/conf/layer.conf
```bitbake
# We have a conf and classes directory, add to BBPATH
BBPATH .= ":${LAYERDIR}"

# We have recipes-* directories, add to BBFILES
BBFILES += "${LAYERDIR}/recipes-*/*/*.bb \
            ${LAYERDIR}/recipes-*/*/*.bbappend"

BBFILE_COLLECTIONS += "meta-rauc-raspberrypi"
BBFILE_PATTERN_meta-rauc-raspberrypi = "^${LAYERDIR}/"
BBFILE_PRIORITY_meta-rauc-raspberrypi = "6"

LAYERDEPENDS_meta-rauc-raspberrypi = "core rauc raspberrypi"
LAYERSERIES_COMPAT_meta-rauc-raspberrypi = "wrynose"

RAUC_KEY_FILE ?= "${LAYERDIR}/../files/rauc-example-keys/development-1.key.pem"
RAUC_CERT_FILE ?= "${LAYERDIR}/../files/rauc-example-keys/development-1.cert.pem"
RAUC_KEYRING_FILE ?= "${LAYERDIR}/../files/rauc-example-keys/ca.cert.pem"
```

## meta-rauc-rockchip/conf/layer.conf
```bitbake
# We have a conf and classes directory, add to BBPATH
BBPATH .= ":${LAYERDIR}"

# We have recipes-* directories, add to BBFILES
BBFILES += "${LAYERDIR}/recipes-*/*/*.bb \
            ${LAYERDIR}/recipes-*/*/*.bbappend"

BBFILE_COLLECTIONS += "meta-rauc-rockchip"
BBFILE_PATTERN_meta-rauc-rockchip = "^${LAYERDIR}/"
BBFILE_PRIORITY_meta-rauc-rockchip = "6"

LAYERDEPENDS_meta-rauc-rockchip = "core"
LAYERSERIES_COMPAT_meta-rauc-rockchip = "styhead"

RAUC_KEY_FILE ?= "${LAYERDIR}/../files/rauc-example-keys/development-1.key.pem"
RAUC_CERT_FILE ?= "${LAYERDIR}/../files/rauc-example-keys/development-1.cert.pem"
RAUC_KEYRING_FILE ?= "${LAYERDIR}/../files/rauc-example-keys/ca.cert.pem"
```

## meta-rauc-st-stm32mp/conf/layer.conf
```bitbake
# We have a conf and classes directory, add to BBPATH
BBPATH .= ":${LAYERDIR}"

# We have recipes-* directories, add to BBFILES
BBFILES += "${LAYERDIR}/recipes-*/*/*.bb \
            ${LAYERDIR}/recipes-*/*/*.bbappend"

BBFILE_COLLECTIONS += "meta-rauc-st-stm32mp"
BBFILE_PATTERN_meta-rauc-st-stm32mp = "^${LAYERDIR}/"
BBFILE_PRIORITY_meta-rauc-st-stm32mp = "7"

LAYERDEPENDS_meta-rauc-st-stm32mp = "core rauc stm-st-stm32mp st-openstlinux"
LAYERSERIES_COMPAT_meta-rauc-st-stm32mp = "scarthgap"
```

## meta-rauc-sunxi/conf/layer.conf
```bitbake
# We have a conf and classes directory, add to BBPATH
BBPATH .= ":${LAYERDIR}"

# We have recipes-* directories, add to BBFILES
BBFILES += "${LAYERDIR}/recipes-*/*/*.bb \
            ${LAYERDIR}/recipes-*/*/*.bbappend"

BBFILE_COLLECTIONS += "meta-rauc-sunxi"
BBFILE_PATTERN_meta-rauc-sunxi = "^${LAYERDIR}/"
BBFILE_PRIORITY_meta-rauc-sunxi = "11"

LAYERDEPENDS_meta-rauc-sunxi = "core rauc"
LAYERSERIES_COMPAT_meta-rauc-sunxi = "whinlatter"

RAUC_KEY_FILE ?= "${LAYERDIR}/../files/rauc-example-keys/development-1.key.pem"
RAUC_CERT_FILE ?= "${LAYERDIR}/../files/rauc-example-keys/development-1.cert.pem"
RAUC_KEYRING_FILE ?= "${LAYERDIR}/../files/rauc-example-keys/ca.cert.pem"
```

## meta-rauc-tegra/conf/layer.conf
```bitbake
# We have a conf and classes directory, add to BBPATH
BBPATH .= ":${LAYERDIR}"

# We have recipes-* directories, add to BBFILES
BBFILES += "${LAYERDIR}/recipes-*/*/*.bb \
            ${LAYERDIR}/recipes-*/*/*.bbappend"

BBFILE_COLLECTIONS += "meta-rauc-tegra"
BBFILE_PATTERN_meta-rauc-tegra = "^${LAYERDIR}/"
BBFILE_PRIORITY_meta-rauc-tegra = "6"

LAYERDEPENDS_meta-rauc-tegra = "core"
LAYERSERIES_COMPAT_meta-rauc-tegra = "dunfell"
```

## wic/sdimage-dual-raspberrypi.wks
```
part /boot --source bootimg-partition --ondisk mmcblk0 --fstype=vfat --label boot --active --align 4096 --size 20
part / --source rootfs --ondisk mmcblk0 --fstype=ext4 --label rootfs_A --align 4096
part / --source rootfs --ondisk mmcblk0 --fstype=ext4 --label rootfs_B --align 4096
```
